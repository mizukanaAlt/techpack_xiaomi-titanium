#include "soc.dtsi"
#include "android.dtsi"
#include "spi.dtsi"
#include "pinctrl.dtsi"
#include "cpu.dtsi"
#include "gpu.dtsi"
#include "sdhc.dtsi"
#include "haptic.dtsi"
#include "audio.dtsi"
#include "display.dtsi"
#include "led.dtsi"
#include "regulator.dtsi"